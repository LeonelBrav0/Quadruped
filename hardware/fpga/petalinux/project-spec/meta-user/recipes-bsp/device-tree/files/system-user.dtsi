/include/ "system-conf.dtsi"
/ {
};


&spi0{
  is-decoded-cs = <0>;
  num-cs = <1>;
  status = "okay";
  bus-num = <0>;
  spidev@0x00 {
    compatible = "spidev";
    spi-max-frequency = <1000000>;
    spi-cpol;
    spi-cpha;
    reg = <0>;
    bus-num = <0>;
  };
};
